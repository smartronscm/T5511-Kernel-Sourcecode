qcom,tron5011-3000mah {
	/* #2067901_CK_RIMO_3000mAh_averaged_MasterSlave_July13th2015*/
	qcom,max-voltage-uv = <4350000>;
	qcom,nom-batt-capacity-mah = <3000>;
	qcom,batt-id-kohm = <0>;
	qcom,battery-beta = <3435>;
	qcom,battery-type = "tron5011_3000mah";
	qcom,chg-rslow-comp-c1 = <3305442>;
	qcom,chg-rslow-comp-c2 = <4996171>;
	qcom,chg-rs-to-rslow = <754738>;
	qcom,chg-rslow-comp-thr = <0xAB>;
	qcom,checksum = <0x826C>;
	qcom,gui-version = "PMI8994GUI - 2.1.6.6";
	qcom,fg-profile-data = [
		 E8 83 EE 7C 
		 EF 80 E2 76 
		 54 83 AA 48 
		 C9 80 19 8C 
		 00 82 04 9B 
		 4A BE CD CB 
		 5C 0E F8 83 
		 F7 7C D7 80 
		 97 76 51 83 
		 D7 6A 47 78 
		 FC 85 3C 82 
		 FE 99 48 BD 
		 64 CA 5A 0E 
		 51 0C 04 5B 
		 CE 6E 77 FE 
		 E1 36 B1 45 
		 EB 40 00 00 
		 51 4C 3F 31 
		 CF 38 00 00 
		 00 00 00 00 
		 00 00 00 00 
		 36 70 72 69 
		 60 5C 2D 90 
		 DF 7D BF 73 
		 BB 6F D9 7B 
		 2A 77 12 70 
		 6C 75 3F A8 
		 23 DC 5A CF 
		 5C A0 71 0C 
		 28 00 FF 36 
		 F0 11 30 03 
		 00 00 00 0C 
	];
};
